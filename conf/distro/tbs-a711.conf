## conf/distro/tbs-a711.conf
```bitbake
DISTRO_VERSION = "1.0"
DISTRO_NAME = "TBS A711 reference distro"

DISTRO_FEATURES = "\
    3g \
    bluetooth \
    bluez5 \
    ext2 \
    keyboard \
    nfs \
    opengl \
    ppp \
    systemd \
    usbhost \
    vfat \
    wayland \
    wifi \
    ${DISTRO_FEATURES_LIBC} \
"
DISTRO_FEATURES_BACKFILL_CONSIDERED = "sysvinit"

VIRTUAL-RUNTIME_dev_manager = "udev"
VIRTUAL-RUNTIME_login_manager = "busybox"
VIRTUAL-RUNTIME_init_manager = "systemd"
VIRTUAL-RUNTIME_initscripts = ""
VIRTUAL-RUNTIME_keymaps = ""

BAD_RECOMMENDATIONS = "busybox-syslog"

TCMODE = "default"
TCLIBC = "glibc"

USER_CLASSES = ""
PACKAGE_CLASSES = "package_ipk"
INHERIT_DISTRO = "debian devshell sstate license"

DEFAULT_TIMEZONE = "Europe/Zurich"

SDK_NAME_PREFIX = "tbs-sdk-a711-arm"
SDK_VENDOR = "-tbs"
SDK_VERSION = "1.0"
```

## conf/layer.conf
```bitbake
# We have a conf and classes directory, append to BBPATH
BBPATH .= ":${LAYERDIR}"

# We have a recipes directory, add to BBFILES
BBFILES += "${LAYERDIR}/recipes*/*/*.bb ${LAYERDIR}/recipes*/*/*.bbappend"

BBFILE_COLLECTIONS += "meta-tbs-a711"
BBFILE_PATTERN_meta-tbs-a711 := "^${LAYERDIR}/"
BBFILE_PRIORITY_meta-tbs-a711 = "50"

LAYERDEPENDS_meta-tbs-a711 = "core"
LAYERDEPENDS_meta-tbs-a711 = "openembedded-layer"
```

## conf/machine/a711.conf
```bitbake
#@TYPE: Machine
#@NAME: TBS A711
#@DESCRIPTION: Machine configuration for Touchless Biometric Systems AG A711 tablet
#@MAINTAINER: Tomas Novotny <tomas.novotny@tbs-biometrics.com>

# A83T: NEON, VFPv4, Thumb-2
DEFAULTTUNE = "cortexa7thf-neon-vfpv4"

require conf/machine/include/tune-cortexa7.inc

MACHINE_FEATURES = "kernel26 usbhost serial ext2 vfat screen touchscreen"

PREFERRED_PROVIDER_virtual/bootloader = "u-boot-tbs-a711"
UBOOT_MACHINE = "tbs_a711_defconfig"

IMAGE_CLASSES += "sdcard_image-a711"
IMAGE_FSTYPES ?= "tar.gz a711-sdimg"
```
